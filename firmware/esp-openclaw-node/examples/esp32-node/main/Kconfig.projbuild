## firmware/esp-openclaw-node/examples/esp32-node/main/Kconfig.projbuild
```kconfig
menu "OpenClaw Example"

config CLAW_BOX_DISPLAY
    bool "Claw Buoy ILI9341 display (fixed Freenove WROOM pins)"
    depends on IDF_TARGET_ESP32
    default n
    help
        Enable only after checking the GPIO table in the repository root README.
        XPT2046 touch is enabled on a separate SPI bus; the return line is shared.
        Backlight control is GPIO17, not the board-reserved GPIO16.

endmenu
```

## firmware/esp-openclaw-node/examples/esp32-node/sdkconfig.defaults
```kconfig
CONFIG_LOG_DEFAULT_LEVEL_INFO=y
CONFIG_MBEDTLS_CERTIFICATE_BUNDLE=y
CONFIG_MBEDTLS_CERTIFICATE_BUNDLE_DEFAULT_FULL=y
CONFIG_MBEDTLS_SSL_PROTO_TLS1_3=y
# Bluetooth scanning increases the application beyond the stock 1.5 MiB slot.
CONFIG_PARTITION_TABLE_CUSTOM=y
CONFIG_PARTITION_TABLE_CUSTOM_FILENAME="partitions.csv"
CONFIG_ESPTOOLPY_FLASHSIZE_4MB=y
CONFIG_BT_ENABLED=y
CONFIG_BT_BLUEDROID_ENABLED=y
CONFIG_BT_BLE_ENABLED=y
CONFIG_BT_CLASSIC_ENABLED=y
CONFIG_BTDM_CTRL_MODE_BTDM=y
CONFIG_BTDM_CTRL_HLI=n
CONFIG_COMPILER_OPTIMIZATION_SIZE=y
```
